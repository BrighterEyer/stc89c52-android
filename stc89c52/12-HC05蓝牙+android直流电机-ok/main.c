/**************************************************************************************
实验现象：下载程序后，直流电机旋转大约5S，然后停止

接线说明： (具体接线图可见开发攻略对应实验的“实验现象”章节)
		   1，单片机-->五线四相步进电机模块
		   		P10-->IN1
		   2，五线四相步进电机模块输出-->直流电机
		   		5V-->直流电机两脚任意一个
				O1-->直流电机两脚任意一个

注意事项：


***************************************************************************************/

#include "reg52.h"      //此文件中定义了单片机的一些特殊功能寄存器
#include <intrins.h>		//因为要用到左右移函数，所以加入这个头文件

typedef unsigned int u16;
typedef unsigned char u8;

sbit led1 = P2 ^ 0;//指示灯0
sbit led2 = P2 ^ 1;//指示灯1
sbit led3 = P2 ^ 2;//指示灯2
sbit led4 = P2 ^ 3;//指示灯3

u16 tmp;
u16 c = 0;

sbit moto = P1 ^ 0;

void init();     //串口初始化
void send(u16 a); //单字节发送函数
void ctrl();     //接收处理函数
void delay(u16 i);

void main()
{

	moto = 0;			//关闭电机
	init();
	while (1)
	{
		// 是否有数据到来
		if (RI == 1)
		{
			RI = 0;
			// 暂存接收到的数据
			tmp = SBUF;
			ctrl();
		}
	}

}


/*******************************************************************************
* 函 数 名         : delay
* 函数功能		   : 延时函数，i=1时，大约延时10us
*******************************************************************************/
void delay(u16 i)
{
	while (i--);
}

//串口初始化
void init()
{
	//关中断
	ES = 0;
	SCON = 0x50;                        // REN=1允许串行接受状态，串口工作模式1,10位UART（1位起始位，8位数据位，1位停止位，无奇偶校验），波特率可变

	TMOD = 0x20;                        // 定时器1工作于方式2，8位自动重载模式, 用于产生波特率
	TH1 = TL1 = 0xFD;                   // 波特率9600 （本次测试采用晶振为11.0592）

	PCON &= 0x7f;                       // 波特率不倍增
	TR1 = 1;                            // 定时器1开始工作，产生波特率
	//发送标志位置0
	TI = 0;                             // 接收标志位置0
	RI = 0;

	//EA=0;
	ES = 1;

	//初始化设置3个指示灯全亮
	led1 = 0;
	led2 = 0;
	led3 = 0;
}

/*中断函数*/
void Uart() interrupt 4
{
    u8 d;
    d=SBUF;        //取出接受到的数据
    RI=0;			  //清除接受中断标志位
}

//单字节数据发送
void send(u16 a) {
//注意：若单片机TXD（P3.1）无上拉能力，必须在P3.1端接上拉电阻。本次测试需要接上拉电阻
	SBUF = a;
	while (!TI);
	TI = 0;

//发送指示灯标志，每接收一次，此灯亮灭交替
	if (c % 2)
		led4 = 1;
	else
		led4 = 0;
	c++;
}

//接收处理函数
void ctrl()
{
	u8 i;
	switch (tmp)
	{
	case 1:
		led1 = 1;  //关闭灯1
		moto = 0;		             //关闭电机
		for (i = 0; i < 100; i++)	 //循环100次，也就是大约5S
		{
			moto = 1;			 //开启电机
			delay(5000);         //大约延时50ms
		}
		moto = 0;		         //关闭电机

		send(tmp);
		break;

	case 2:
		led2 = 1;	    //关闭灯2
		moto = 0;		//关闭电机
		send(tmp);
		break;

	case 3:
		led3 = 1;       //关闭灯3
		moto = 1;	    //开启电机
		send(tmp);
		break;

	default:
		led1 = 0;
		led2 = 0;
		led3 = 0;

		send(tmp);
	}
}